## meta-demo/conf/layer.conf
```bitbake
# This software is a part of isar demo.
# Copyright (c) Siemens AG, 2025
#
# SPDX-License-Identifier: MIT

BBPATH .= ":${LAYERDIR}"

BBFILES += "${LAYERDIR}/recipes-*/*/*.bb \
        ${LAYERDIR}/recipes-*/*/*.bbappend"

BBFILE_COLLECTIONS += "meta-demo"
BBFILE_PATTERN_meta-demo = "^${LAYERDIR}/recipes-"
BBFILE_PRIORITY_meta-demo = "7"

LAYERSERIES_COMPAT_meta-demo = "next"

LAYERDIR_meta-demo = "${LAYERDIR}"
```
